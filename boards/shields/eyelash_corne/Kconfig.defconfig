## boards/shields/eyelash_corne/Kconfig.defconfig
```kconfig
# Copyright (c) 2024 The ZMK Contributors
# SPDX-License-Identifier: MIT

if SHIELD_EYELASH_CORNE_LEFT

config ZMK_KEYBOARD_NAME
    default "Eyelash Corne"

config ZMK_SPLIT_ROLE_CENTRAL
    default y

# DYA Studio Level 2: Macro / Combo tabs (central only)
config ZMK_RUNTIME_MACRO
    default y

config ZMK_RUNTIME_MACRO_STUDIO_RPC
    default y

config ZMK_RUNTIME_COMBO
    default y

config ZMK_RUNTIME_COMBO_STUDIO_RPC
    default y

# 10 combos migrated from the old zmk,combos node; default cap is 8
config ZMK_RUNTIME_COMBO_MAX_COMBOS
    default 16

# Stack/buffer baseline for running multiple Studio RPC feature modules
config ZMK_LOW_PRIORITY_THREAD_STACK_SIZE
    default 4096

config ZMK_STUDIO_RPC_RX_BUF_SIZE
    default 256

config ZMK_STUDIO_RPC_TX_BUF_SIZE
    default 256

config ZMK_STUDIO_RPC_CUSTOM_SUBSYSTEM_REQUEST_PAYLOAD_MAX_BYTES
    default 256

config ZMK_STUDIO_RPC_THREAD_STACK_SIZE
    default 6000

config SYSTEM_WORKQUEUE_STACK_SIZE
    default 4096

endif # SHIELD_EYELASH_CORNE_LEFT

if SHIELD_EYELASH_CORNE_RIGHT

config ZMK_USB
    default n

endif # SHIELD_EYELASH_CORNE_RIGHT

if SHIELD_EYELASH_CORNE_LEFT || SHIELD_EYELASH_CORNE_RIGHT

config ZMK_SPLIT
    default y

config BT_CTLR
    default BT

if ZMK_BACKLIGHT

config PWM
    default y

config LED_PWM
    default y

endif # ZMK_BACKLIGHT

endif # SHIELD_EYELASH_CORNE_LEFT || SHIELD_EYELASH_CORNE_RIGHT
```

## config/west.yml
```yaml
manifest:
  version: 1.2
  defaults:
    remote: cormoran
    revision: main
  remotes:
    - name: cormoran
      url-base: https://github.com/cormoran
    - name: zmkfirmware
      url-base: https://github.com/zmkfirmware
    - name: eyelash
      url-base: https://github.com/a741725193
    - name: tokyo2006
      url-base: https://github.com/tokyo2006
  projects:
    - name: zmk
      remote: cormoran
      import: app/west.yml
      revision: main+dya
      clone-depth: 1
    - name: zephyr
      remote: cormoran
      revision: v4.1.0+zmk-fixes+nrf-half-duplex-uart
      clone-depth: 1
      import:
        name-blocklist:
          - ci-tools
          - hal_altera
          - hal_cypress
          - hal_infineon
          - hal_microchip
          - hal_nxp
          - hal_openisa
          - hal_xtensa
          - hal_st
          - hal_ti
          - loramac-node
          - mcuboot
          - mcumgr
          - net-tools
          - openthread
          - edtt
          - trusted-firmware-m
          - chre
    - name: zmk-board-eyelash
      remote: eyelash
      revision: v4.0
    - name: zmk-nice-oled
      remote: tokyo2006
      revision: "4.0"
  self:
    path: config
```
